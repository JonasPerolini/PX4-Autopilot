## src/modules/navigator/Kconfig
```kconfig
menuconfig MODULES_NAVIGATOR
	bool "navigator"
	default n
	---help---
		Enable support for navigator

menuconfig USER_NAVIGATOR
	bool "navigator running as userspace module"
	default y
	depends on BOARD_PROTECTED && MODULES_NAVIGATOR
	---help---
		Put navigator in userspace memory

menuconfig MODE_NAVIGATOR_VTOL_TAKEOFF
	bool "Include VTOL takeoff mode support"
	default n
	depends on MODULES_NAVIGATOR
	---help---
		Add VTOL takeoff mode to enable support for MAV_CMD_NAV_VTOL_TAKEOFF.
		The VTOL takes off in MC mode and transition to FW. The mode ends with
		an infinite loiter

menuconfig NAVIGATOR_ADSB
	bool "Include traffic reporting and avoidance"
	default y
	depends on MODULES_NAVIGATOR
	---help---
		Add support for acting on ADSB transponder_report or ADSB_VEHICLE MAVLink messages.
		Actions are warnings, Loiter, Land and RTL without climb.

menuconfig RTL_MISSION_CACHE_SIZE
	int "Maximum number of mission items cached for route planning"
	default 100 if BOARD_TESTING
	default 0
	depends on MODULES_NAVIGATOR
	---help---
		Maximum number of mission items reserved in RAM for full-route planning helpers.
		Set this to 0 to disable the route-mission cache on boards that have not been sized for the extra RAM.
		Each reserved cached item uses approximately 76 bytes of heap for the lifetime of Navigator.
```
